## test_data/17_firmware/linux/Kconfig
```kconfig
menu "General Setup"

config LOCALVERSION
    string "Local version - append to kernel release"
    default "-vmake"

config ARCH
    string "Architecture"
    default "x86_64"

endmenu

menu "Device Drivers"

config NET
    bool "Networking support"
    default y

config BLK_DEV
    bool "Block device support"
    default y

config I2C
    bool "I2C support"
    default y

config SPI
    bool "SPI support"
    default n

config SERIAL
    bool "Serial driver"
    default y

config GPIO
    bool "GPIO support"
    default y

endmenu

menu "File systems"

config EXT4
    bool "Ext4 filesystem"
    default y

config SQUASHFS
    bool "SquashFS support"
    default y

config OVERLAY_FS
    bool "Overlay filesystem"
    default n

endmenu
```

## test_data/17_firmware/linux/configs/rk3568_defconfig
```kconfig
CONFIG_LOCALVERSION="-vmake"
CONFIG_ARCH="arm64"
CONFIG_NET=y
CONFIG_BLK_DEV=y
CONFIG_I2C=y
CONFIG_SPI=y
CONFIG_SERIAL=y
CONFIG_GPIO=y
CONFIG_EXT4=y
CONFIG_SQUASHFS=y
CONFIG_OVERLAY_FS=y
CONFIG_PCI=y
CONFIG_MMC=y
CONFIG_REGULATOR=y
CONFIG_DRM=y
```

## test_data/17_firmware/linux/configs/stm32_defconfig
```kconfig
CONFIG_LOCALVERSION="-vmake"
CONFIG_ARCH="arm"
CONFIG_NET=y
# CONFIG_BLK_DEV is not set
# CONFIG_I2C is not set
# CONFIG_SPI is not set
CONFIG_SERIAL=y
# CONFIG_GPIO is not set
CONFIG_MTD=y
CONFIG_MTD_SPI_NOR=y
# CONFIG_EXT4 is not set
CONFIG_SQUASHFS=y
# CONFIG_OVERLAY_FS is not set
# CONFIG_PCI is not set
# CONFIG_MMC is not set
# CONFIG_DRM is not set
# CONFIG_REGULATOR is not set
```

## test_data/17_firmware/uboot/configs/stm32_defconfig
```kconfig
CONFIG_VERSION="2024.01"
CONFIG_FIT=y
CONFIG_ENV_SIZE=0x40000
CONFIG_BOARD_NAME="stm32mp157"
CONFIG_MMC=y
CONFIG_SPI_FLASH=y
CONFIG_SERIAL=y
CONFIG_GPIO=y
CONFIG_USB=y
CONFIG_FDT=y
CONFIG_OF_CONTROL=y
CONFIG_OPTEE=y
CONFIG_ARMV7_PSCI=y
```

## test_linux/17_firmware/busybox/configs/defconfig
```kconfig
# CONFIG_FEATURE_SH_IS_ASH is not set
CONFIG_FEATURE_SH_IS_ASH=y
# CONFIG_FEATURE_SH_IS_HUSH is not set
CONFIG_ASH=y
CONFIG_ASH_INTERNAL_GLOB=y
CONFIG_ASH_BASH_COMPAT=y
CONFIG_ASH_JOB_CONTROL=y
CONFIG_ASH_ALIAS=y
CONFIG_ASH_GETOPTS=y
CONFIG_ASH_RANDOM_SUPPORT=y
CONFIG_ASH_EXPAND_PRMT=y
CONFIG_CAT=y
CONFIG_CP=y
CONFIG_LS=y
CONFIG_MV=y
CONFIG_RM=y
CONFIG_MKDIR=y
CONFIG_CHMOD=y
CONFIG_CHOWN=y
CONFIG_ECHO=y
CONFIG_SLEEP=y
CONFIG_DATE=y
CONFIG_PRINTF=y
CONFIG_WC=y
CONFIG_HEAD=y
CONFIG_TAIL=y
CONFIG_TEE=y
CONFIG_TOUCH=y
CONFIG_MKNOD=y
CONFIG_MKTEMP=y
CONFIG_GREP=y
CONFIG_FIND=y
CONFIG_XARGS=y
CONFIG_SED=y
CONFIG_AWK=y
CONFIG_CUT=y
CONFIG_TR=y
CONFIG_WHOAMI=y
CONFIG_UNAME=y
CONFIG_HOSTNAME=y
CONFIG_PWD=y
CONFIG_CD=y
CONFIG_TRUE=y
CONFIG_FALSE=y
CONFIG_TEST=y
CONFIG_BASENAME=y
CONFIG_DIRNAME=y
CONFIG_EXPR=y
CONFIG_TTY=y
CONFIG_IONICE=y
CONFIG_UMOUNT=y
CONFIG_MOUNT=y
CONFIG_MOUNT_POINT=y
CONFIG_INIT=y
CONFIG_FEATURE_USE_INITTAB=y
CONFIG_FEATURE_INIT_SCTTY=y
CONFIG_HALT=y
CONFIG_POWEROFF=y
CONFIG_REBOOT=y
CONFIG_KILL=y
CONFIG_KILLALL=y
CONFIG_PIDOF=y
CONFIG_PS=y
CONFIG_CLEAR=y
CONFIG_RESET=y
CONFIG_DMESG=y
CONFIG_ENV=y
CONFIG_PRINTENV=y
CONFIG_EXPORT=y
CONFIG_READLINK=y
CONFIG_LN=y
CONFIG_STAT=y
CONFIG_DF=y
CONFIG_DU=y
CONFIG_MD5SUM=y
CONFIG_SHA256SUM=y
CONFIG_FREE=y
CONFIG_UPTIME=y
CONFIG_SORT=y
CONFIG_UNIQ=y
CONFIG_WC=y
CONFIG_TAR=y
CONFIG_GZIP=y
CONFIG_GUNZIP=y
CONFIG_ZCAT=y
CONFIG_BZIP2=y
CONFIG_BUNZIP2=y
CONFIG_XZ=y
CONFIG_UNXZ=y
CONFIG_IP=y
CONFIG_IFCONFIG=y
CONFIG_ROUTE=y
CONFIG_PING=y
CONFIG_NETSTAT=y
CONFIG_WGET=y
CONFIG_TFTP=y
CONFIG_TELNET=y
CONFIG_VI=y
CONFIG_TOP=y
CONFIG_FEATURE_TOP_SMP_PROCESS=y
CONFIG_FEATURE_SHOW_THREADS=y
```

## test_linux/17_firmware/linux/configs/defconfig
```kconfig
CONFIG_LOCALVERSION="-vmake"
CONFIG_ARCH="x86_64"
CONFIG_NET=y
CONFIG_BLK_DEV=y
CONFIG_I2C=y
# CONFIG_SPI is not set
CONFIG_SERIAL=y
CONFIG_GPIO=y
CONFIG_EXT4=y
CONFIG_SQUASHFS=y
# CONFIG_OVERLAY_FS is not set
```

## test_linux/17_firmware/uboot/Kconfig
```kconfig
menu "General Settings"

config VERSION
    string "U-Boot version string"
    default "2024.01"

config FIT
    bool "Support Flattened Image Tree (FIT)"
    default y

config ENV_SIZE
    hex "Environment size"
    default 0x10000

config BOARD_NAME
    string "Board name"
    default "sandbox"

endmenu

menu "Device Drivers"

config MMC
    bool "MMC/SD support"
    default y

config NET
    bool "Networking support"
    default y

config NET_DHCP
    bool "DHCP support"
    depends on CONFIG_NET
    default y

config SERIAL
    bool "Serial driver"
    default y

config GPIO
    bool "GPIO support"
    default n

config USB
    bool "USB support"
    default n

endmenu
```

## test_linux/17_firmware/uboot/configs/rk3568_defconfig
```kconfig
CONFIG_VERSION="2024.01"
CONFIG_FIT=y
CONFIG_ENV_SIZE=0x20000
CONFIG_BOARD_NAME="rk3568-evb"
CONFIG_MMC=y
CONFIG_SPI_FLASH=y
CONFIG_NET=y
CONFIG_NET_DHCP=y
CONFIG_SERIAL=y
CONFIG_GPIO=y
CONFIG_USB=y
CONFIG_USB_GADGET=y
CONFIG_FDT=y
CONFIG_OF_CONTROL=y
```

## test_linux/17_firmware/uboot/configs/sandbox_defconfig
```kconfig
CONFIG_VERSION="2024.01"
CONFIG_FIT=y
CONFIG_ENV_SIZE=0x10000
CONFIG_BOARD_NAME="sandbox"
CONFIG_MMC=y
CONFIG_NET=y
CONFIG_NET_DHCP=y
CONFIG_SERIAL=y
# CONFIG_GPIO is not set
# CONFIG_USB is not set
```
